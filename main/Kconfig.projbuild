## main/Kconfig.projbuild
```kconfig
menu "Example Configuration"

    config ESP_WIFI_SSID
        string "SoftAP SSID"
        default "Smart switch"
        help
            SSID (network name) to set up the softAP with.

    config ESP_WIFI_PASSWORD
        string "SoftAP Password"
        default ""
        help
            WiFi password (WPA or WPA2) for the example to use for the softAP.

    config ESP_MAX_STA_CONN
        int "Maximal STA connections"
        default 4
        help
            Max number of the STA connects to AP.

    config BROKER_URL
        string "Broker URL"
        default "mqtt://mqtt.eclipseprojects.io"
        help
            URL of the broker to connect to

    config BROKER_URL_FROM_STDIN
        bool
        default y if BROKER_URL = "FROM_STDIN"

	config CONFIG_OPENTHREAD_RX_ON_WHEN_IDLE
		bool
		default y

endmenu

menu "MPR121 Configuration"

	config GPIO_RANGE_MAX
		int
		default 33 if IDF_TARGET_ESP32
		default 46 if IDF_TARGET_ESP32S2
		default 48 if IDF_TARGET_ESP32S3
		default 18 if IDF_TARGET_ESP32C2
		default 19 if IDF_TARGET_ESP32C3
		default 30 if IDF_TARGET_ESP32C6

	config I2C_ADDRESS
		hex "I2C address"
		default 0x5A
		help
			I2C address.

	config SCL_GPIO
		int "SCL GPIO number"
		range 0 GPIO_RANGE_MAX
		default 22 if IDF_TARGET_ESP32
		default 12 if IDF_TARGET_ESP32S2 || IDF_TARGET_ESP32S3
		default  6 # C3 and others
		help
			GPIO number (IOxx) to SCL.
			Some GPIOs are used for other purposes (flash connections, etc.) and cannot be used to blink.

	config SDA_GPIO
		int "SDA GPIO number"
		range 0 GPIO_RANGE_MAX
		default 21 if IDF_TARGET_ESP32
		default 11 if IDF_TARGET_ESP32S2 || IDF_TARGET_ESP32S3
		default  5 # C3 and others
		help
			GPIO number (IOxx) to SDA.
			Some GPIOs are used for other purposes (flash connections, etc.) and cannot be used to blink.

	config IRQ_GPIO
		int "IRQ GPIO number"
		range 0 GPIO_RANGE_MAX
		default 15 if IDF_TARGET_ESP32
		default 18 if IDF_TARGET_ESP32S2 || IDF_TARGET_ESP32S3
		default  4 # C3 and others
		help
			GPIO number (IOxx) to IRQ.
			Some GPIOs are used for other purposes (flash connections, etc.) and cannot be used to blink.

endmenu
```
